#pragma once

#include <Arduino.h>
#include <Locator.h>
#include "picopixel.h"
#include "bigfont.h"
#include "night_font.h"
#include <qrcode.h>
#include <esp_ota_ops.h>

#define ESP32_LED_BUILTIN 2

const uint8_t CW_STATUS_NTP[] PROGMEM = {
	0x00, 0x00, 0x00, 0x00, 0x00, 0x00, 0x00, 0x00, 0x3f, 0xff, 0xf0, 0x00, 0x40, 0x00, 0x08, 0x01, 
	0x4b, 0x8e, 0xe8, 0x03, 0x58, 0xaa, 0xa8, 0x07, 0x4b, 0x8a, 0xa8, 0x67, 0x4a, 0x2a, 0xa8, 0xf7, 
	0x4b, 0x8e, 0xe9, 0xff, 0x40, 0x00, 0x0b, 0xff, 0x3f, 0xff, 0xf3, 0xff, 0x00, 0x00, 0x03, 0xff, 
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	0x00, 0x00, 0x00, 0x00, 0x00, 0x00, 0x00, 0x00, 0x00, 0x00, 0x00, 0x00, 0x00, 0x00, 0x00, 0x00
};

const uint8_t CW_STATUS_WIFI[] PROGMEM = {
	0x00, 0x00, 0x00, 0x00, 0x00, 0x00, 0x00, 0x00, 0x00, 0x00, 0x00, 0x00, 0x00, 0x00, 0x00, 0x00, 
	0x00, 0x00, 0x00, 0x00, 0x00, 0x0f, 0xf0, 0x00, 0x00, 0xff, 0xff, 0x00, 0x03, 0xff, 0xff, 0xc0, 
	0x0f, 0xff, 0xff, 0xf0, 0x1f, 0xff, 0xff, 0xf8, 0x7f, 0xf8, 0x1f, 0xfe, 0xff, 0xc0, 0x03, 0xff, 
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	0x00, 0x00, 0x00, 0x00, 0x00, 0x00, 0x00, 0x00, 0x00, 0x00, 0x00, 0x00, 0x00, 0x00, 0x00, 0x00
};

const uint8_t CW_STATUS_DINO[] PROGMEM = {
	0x00, 0xff, 0xff, 0x00, 0x03, 0xf8, 0x1f, 0xc0, 0x07, 0xc0, 0x03, 0xe0, 0x0f, 0x00, 0x00, 0xf0, 
	0x1e, 0x00, 0x00, 0x78, 0x3c, 0x00, 0x00, 0x3c, 0x78, 0x1f, 0xff, 0x9e, 0x70, 0x3f, 0xff, 0xee, 
	0xe0, 0x33, 0xff, 0xe7, 0xe0, 0x73, 0xff, 0xe7, 0xc0, 0x7f, 0xff, 0xe3, 0xc0, 0x7f, 0xff, 0xe3, 
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	0x0f, 0xfe, 0x00, 0xf0, 0x07, 0xfc, 0x03, 0xe0, 0x03, 0xfc, 0x1f, 0xc0, 0x00, 0xff, 0xff, 0x00
};


const unsigned short bdFlags[1100] PROGMEM={
0x0000, 0x52A4, 0x73C6, 0x0880, 0x0000, 0x0000, 0x0000, 0x0000, 0x0000, 0x0000, 0x0000, 0x0000, 0x0000, 0x0000, 0x0000, 0x0000,   // 0x0010 (16) pixels
0x0000, 0x0000, 0x0000, 0x0000, 0x0000, 0x0000, 0x0000, 0x0000, 0x0000, 0x0000, 0x0000, 0x0000, 0x0000, 0x0000, 0x0000, 0x0000,   // 0x0020 (32) pixels
0x0000, 0x0000, 0x0000, 0x0000, 0x0000, 0x0000, 0x0000, 0x0000, 0x0000, 0x0000, 0x0000, 0x0000, 0x0000, 0x0000, 0x0000, 0x0000,   // 0x0030 (48) pixels
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0x1863, 0x0000, 0x0000, 0x0000, 0x0000, 0x0000, 0x0000, 0x0000, 0x0000, 0x0000, 0x0000, 0x0000, 0x0000, 0x0000, 0x0000, 0x0000,   // 0x0440 (1088) pixels
};

struct StatusController
{

	static StatusController *getInstance()
	{
		static StatusController base;
		return &base;
	}

	void wifiConnecting()
	{
		Locator::getDisplay()->fillRect(0, 16, 64, 48, 0);
		Locator::getDisplay()->drawBitmap(16, 16, CW_STATUS_WIFI, 32, 32, 0x2459);
		printCenter("Connecting WiFi", 52);
		// #ifdef DOUBLE_BUFFER_ON
		//   dma_display->flipDMABuffer();
		// #endif
	}

	void wifiConnectionFailed(const char *msg)
	{
		Locator::getDisplay()->fillRect(0, 16, 64, 48, 0);
		Locator::getDisplay()->drawBitmap(16, 16, CW_STATUS_WIFI, 32, 32, 0xFA28);
		printCenter(msg, 52);
		// #ifdef DOUBLE_BUFFER_ON
		//   dma_display->flipDMABuffer();
		// #endif
	}

	// QR code that joins the setup access point. 64x64 panels only.
	// Lit modules on black: a big lit area blooms and fools the phone camera's exposure.
	void wifiSetupQr(const char *ssid)
	{
		if (!showQr(String("WIFI:T:nopass;S:") + ssid + ";;"))
			wifiConnectionFailed("Setup WiFi via AP");
	}

	// Returns false when the text doesn't fit in a code. With a caption the code is drawn at
	// 2px per module to leave room under it (only possible for the 25 module version).
	// countdown > 0 (seconds left): the last 9 seconds are counted in the top right corner.
	bool showQr(const String &payload, const char *caption = nullptr, int countdown = 0)
	{
		static uint8_t qrData[128];  // version 3 needs 106 bytes
		QRCode qr;

		// Version 2 (25 modules) leaves a proper quiet zone; 3 is the fallback for longer names
		if (qrcode_initBytes(&qr, qrData, 2, ECC_LOW, (uint8_t *)payload.c_str(), payload.length()) < 0 &&
			qrcode_initBytes(&qr, qrData, 3, ECC_LOW, (uint8_t *)payload.c_str(), payload.length()) < 0)
			return false;

		const int quiet = 1;
		int total = qr.size + 2 * quiet;
		auto display = Locator::getDisplay();
		display->fillScreen(0);

		if (caption && qr.size <= 25)
		{
			int left = (64 - total * 2) / 2;
			for (uint8_t y = 0; y < qr.size; y++)
				for (uint8_t x = 0; x < qr.size; x++)
					if (qrcode_getModule(&qr, x, y))
						display->fillRect(left + (x + quiet) * 2, (y + quiet) * 2, 2, 2, 0xFFFF);
			printCenter(caption, 61);
			// The caption takes the whole bottom line, so the countdown goes in the free top right corner
			if (countdown > 0 && countdown <= 9)
			{
				Locator::getDisplay()->setCursor(60, 5);
				Locator::getDisplay()->print(countdown);
			}
			return true;
		}

		// Scale to the panel: modules come out 2 or 3 px wide. One module of black margin is
		// enough on a dark panel (none at all decoded unreliably when tested).
		for (uint8_t y = 0; y < qr.size; y++)
			for (uint8_t x = 0; x < qr.size; x++)
				if (qrcode_getModule(&qr, x, y))
				{
					int x0 = ((x + quiet) * 64) / total, x1 = ((x + quiet + 1) * 64) / total;
					int y0 = ((y + quiet) * 64) / total, y1 = ((y + quiet + 1) * 64) / total;
					display->fillRect(x0, y0, x1 - x0, y1 - y0, 0xFFFF);
				}
		return true;
	}

	void wifiRetrying()
	{
		Locator::getDisplay()->fillScreen(0);
		wifiConnecting();
	}

	void wifiSetupDone()
	{
		Locator::getDisplay()->fillScreen(0);
	}

	void ntpConnecting()
	{
		Locator::getDisplay()->fillRect(0, 24, 64, 52, 0);
		Locator::getDisplay()->drawBitmap(16, 24, CW_STATUS_NTP, 32, 32, 0xBCBF);
		printCenter("NTP Server", 61);
		// #ifdef DOUBLE_BUFFER_ON
		//   dma_display->flipDMABuffer();
		// #endif
	}

	void printCenter(const char *buf, int y)
	{
		int16_t x1, y1;
		uint16_t w, h;
		Locator::getDisplay()->setFont(&Picopixel);
		Locator::getDisplay()->getTextBounds(buf, 0, y, &x1, &y1, &w, &h);
		Locator::getDisplay()->setCursor(32 - (w / 2), y);
		Locator::getDisplay()->setTextColor(0xffff);
		Locator::getDisplay()->print(buf);
	}

	void forceRestart()
	{
		delay(1000);
		ESP.restart();
	}

	// A restart someone asked for proves the firmware is alive, so a new build must
	// not roll back because of it. Automatic restarts (forceRestart) still can.
	void userRestart()
	{
		esp_ota_mark_app_valid_cancel_rollback();
		forceRestart();
	}
};